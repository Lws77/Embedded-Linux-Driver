/dts-v1/;
/plugin/;

/ {
    compatible = "rockchip,rk3568";
    fragment@0 {
        target = <&i2c2>;
        __overlay__ {
            #address-cells = <1>;
            #size-cells = <0>;
            arduino-i2c@8 {
                compatible = "arduino";
                reg = <0x8>;
				status = "okay";
            };
        };
    };
};
